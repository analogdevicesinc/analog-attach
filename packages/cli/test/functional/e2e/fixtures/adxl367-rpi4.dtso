/dts-v1/;
/plugin/;
/ {
	fragment@0 {
		target = <&spi0>;
		__overlay__ {
			status = "okay";
			adxl367: accel@0 {
				compatible = "adi,adxl367";
				reg = <0>;
				vdd-supply = <&vdd_3v3_reg>;
				vddio-supply = <&vdd_3v3_reg>;
				interrupt-parent = <&gpio>;
				interrupts = <25 1>;
				spi-max-frequency = <1000000>;
			};
		};
	};
	fragment@1 {
		target = <&spidev0>;
		__overlay__ {
			status = "disabled";
		};
	};
};
