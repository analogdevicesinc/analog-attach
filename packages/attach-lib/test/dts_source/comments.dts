/dts-v1/;

// 1

/*
2
*/

/ /* 3 */ { // 4
	compatible /* 5 */ = /* 6 */ "simple-bus" /* 7 */; // 8
}; /* 9 */ // 10

/*
AUTO-GENERATED BY ANALOG ATTACH - DO NOT DELETE OR MODIFY
Required for Analog Attach features. Remove only when devicetree is finalized.
---
version: 0.1.0
modifications:
  - /abs/path/to/modified/1
  - /abs/path/to/modified/2
  - /abs/path/to/modified/3
  - /abs/path/to/modified/4
...
*/

// 11
