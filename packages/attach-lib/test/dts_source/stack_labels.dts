/dts-v1/;

/{
	first_label: prop = value_label1: <&spi1>;
	
	a_label: node{
		cool_prop = <0>;
	};
};

/{
	second_label: prop = value_label2: <&spi2>;
	
	b_label: node{
		cool_prop = <1>;
	};
};

c_label: &b_label {};